## main/Kconfig.projbuild
```kconfig
menu "ESP32 stream configuration"

    config STREAM_WIFI_SSID
        string "Wi-Fi SSID"
        default "esp32-stream"
        help
            SSID advertised by the ESP32 access point.

    config STREAM_WIFI_PASSWORD
        string "Wi-Fi password"
        default "esp32stream"
        help
            WPA2 password for the ESP32 access point. Leave empty for an open
            access point.

    config STREAM_WIFI_CHANNEL
        int "Wi-Fi channel"
        range 1 13
        default 1
        help
            Channel used by the ESP32 access point.

    config STREAM_MAX_STA_CONNECTIONS
        int "Maximum station connections"
        range 1 4
        default 2
        help
            Maximum number of clients allowed to connect to the access point.
            This is distinct from the number of HTTP stream connections because
            one Wi-Fi station may open more than one TCP connection.

    config STREAM_MAX_HTTP_CLIENTS
        int "Maximum simultaneous HTTP stream clients"
        range 1 2
        default 2
        help
            Number of long-running GET /stream responses. Each client receives
            the newest selected GNSS packet. Keep this bounded because every
            connected stream owns a FreeRTOS worker task and a socket.

    config GNSS_SELECTION_WINDOW_MS
        int "GNSS quality selection window in milliseconds"
        range 100 60000
        default 500
        help
            Publish the lowest-HDOP valid GGA/RMC pair received during each
            fixed timer window. The default 500 ms window allows up to 2 Hz
            output, but a window with no new valid pair publishes nothing.

    config OTA_CONFIRM_TIMEOUT_SECONDS
        int "OTA confirmation timeout in seconds"
        range 10 600
        default 60
        help
            A newly booted OTA image must receive POST /flash/confirm before
            this timeout expires. Otherwise the device reboots and ESP-IDF's
            bootloader rolls back to the previous working application.

endmenu
```

## sdkconfig.defaults
```kconfig
CONFIG_ESPTOOLPY_FLASHSIZE_4MB=y
CONFIG_PARTITION_TABLE_TWO_OTA=y
CONFIG_BOOTLOADER_APP_ROLLBACK_ENABLE=y
```
